## dts/bindings/input/azoteq,iqs9151.yaml
```yaml
description: |
  Azoteq IQS9151 capacitive trackpad driver.

compatible: "azoteq,iqs9151"

include: i2c-device.yaml

properties:
  irq-gpios:
    type: phandle-array
    required: true
    description: Active-low RDY input. Use GPIO_ACTIVE_LOW; module has a pull-up.
  reset-gpios:
    type: phandle-array
    description: |
      Optional active-low MCLR output. Use GPIO_ACTIVE_LOW. Omit this
      property when connector pin 1 is unconnected; software reset is used.
      Do not connect this pin to GND with the A2 R5 link populated.
```

## tests/iqs9151_work_cb/testcase.yaml
```yaml
tests:
  iqs9151.work_cb:
    tags: [iqs9151, input]
    platform_allow: [native_sim, qemu_cortex_m3]
  iqs9151.work_cb.a2:
    tags: [iqs9151, input]
    platform_allow: [native_sim, qemu_cortex_m3]
    extra_args: IQS9151_TEST_A2=ON
  iqs9151.work_cb.a2_survey:
    tags: [iqs9151, input]
    platform_allow: [qemu_cortex_m3]
    extra_args: [IQS9151_TEST_A2=ON, IQS9151_TEST_SURVEY=ON]
```
